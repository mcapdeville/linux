## drivers/misc/Kconfig.rej
```kconfig
--- drivers/misc/Kconfig
+++ drivers/misc/Kconfig
@@ -538,4 +538,5 @@
 source "drivers/misc/mei/Kconfig"
 source "drivers/misc/vmw_vmci/Kconfig"
 source "drivers/misc/vc04_services/Kconfig"
+source "drivers/misc/vs10xx/Kconfig"
 endmenu
```

## drivers/misc/vs10xx/Kconfig
```kconfig
config VS10XX
	tristate "vs10xx platform driver"
	default n
	help
		Kernel to vs10xx communication interface for the
		vs1053 && vs1063 codecs from vlsi.
```
